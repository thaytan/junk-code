#include <SPI.h>

const int chipSelectPin = 10;
const int mosiPin = 11;
const int misoPin = 12;
const int sclkPin = 13;
const int dataIntrPin = 2;

const unsigned short regSettings[] = 
{
  0x46C5,
  
  0xA620,
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  0xCE87,
  0xC081
};

#define PKT_SIZE 11
#define RXBUF_SIZE (PKT_SIZE*2)

byte RXBUF[RXBUF_SIZE];
byte *cur_rxbuf;
byte last_byte0 = 0;
int rxbuf_pos = 0;

void setup() {
  int i;
  
  Serial.begin(115200);
  
  pinMode(chipSelectPin, OUTPUT);
  pinMode(mosiPin, OUTPUT);
  pinMode(misoPin, INPUT);
  pinMode(sclkPin, OUTPUT);
  pinMode(dataIntrPin, INPUT); // interrupt signal

  SPI.setDataMode(SPI_MODE0);
  SPI.setBitOrder(MSBFIRST);
  SPI.setClockDivider(SPI_CLOCK_DIV8);
  SPI.begin();
  
  digitalWrite(chipSelectPin, HIGH);

  delay(100); // let the receiver wake up
  
  // init transceiver
  for (i = 0; i < sizeof(regSettings) / sizeof(regSettings[1]); i ++) {
    sendCMD(regSettings[i]);
  }
  
  for (i = 0; i < RXBUF_SIZE; i++)
    RXBUF[i] = 0;
    
  cur_rxbuf = RXBUF;
  
  Serial.print("EasyWeather receive init: ");
  Serial.println(millis());
}

void check_and_print_rxbuf()
{
  int i;
  byte *prev_rxbuf;
  
  if (cur_rxbuf == RXBUF) {
    prev_rxbuf = RXBUF + PKT_SIZE;
  } else {
    prev_rxbuf = RXBUF;
  }
  
  for (i = 0; i < PKT_SIZE; i++) {
    if (cur_rxbuf[i] != prev_rxbuf[i])
      break;
  }
  if (i == PKT_SIZE)
    return; // no change from previous packet, don't print
  
  if (calc_crc(cur_rxbuf, 10) != 0) {
    Serial.print("# BAD CRC ");
    for (int i = 0; i < PKT_SIZE; i++) {
      Serial.print(cur_rxbuf[i], 16);
      Serial.print(" ");
    }
    Serial.println("");
    return; // CRC failure - corruption or invalid
  }
  if ((last_byte0 != 0 && cur_rxbuf[0] != last_byte0) || cur_rxbuf[10] != 0) {
    Serial.print("# BAD pkt ");
    for (int i = 0; i < PKT_SIZE; i++) {
      Serial.print(cur_rxbuf[i], 16);
      Serial.print(" ");
    }
    Serial.println("");
    return; // invalid packet
  }

  last_byte0 = cur_rxbuf[0];
  for (int i = 0; i < PKT_SIZE; i++) {
   Serial.print(cur_rxbuf[i], 16);
   Serial.print(" ");
  }
  Serial.println(millis());
  
  cur_rxbuf = prev_rxbuf; // swap buffers
}

void loop()
{
  while (digitalRead(dataIntrPin) == 0) {
    // Data byte  
    byte data;
    
    if (readFIFO(&data)) {
      cur_rxbuf[rxbuf_pos++] = data;      
      if (rxbuf_pos == PKT_SIZE) {
          
        // Disable RX & clear FIFO
        sendCMD(0xC080);
        sendCMD(0xCE84);

        check_and_print_rxbuf();
        
        rxbuf_pos = 0;
        
        // reenable RX & FIFO
        sendCMD(0xCE87);
        sendCMD(0xC081);          
      }      
    }
  }
}

int readFIFO(byte *out)
{
  byte data, i, b;   
  
  digitalWrite(chipSelectPin, LOW);

  // read 3 bytes: 2 status bytes, one byte of FIFO
  data = SPI.transfer(0x00);
  if (data & 0x40)
    Serial.print("!");
  if ((data & 0x80) == 0)
     goto done; // IRQ wasn't because of data fill

  data = SPI.transfer(0x00); // ignore 2nd status byte
  data = SPI.transfer(0x00); // 3rd byte is actual data

      digitalWrite(chipSelectPin, HIGH);
  
  *out = data;
  return 1;
done:
  digitalWrite(chipSelectPin, HIGH);
  return 0;    
}

void sendCMD(unsigned short cmd)
{
  digitalWrite(chipSelectPin, LOW);

  SPI.transfer(cmd >> 8);
  SPI.transfer(cmd & 0xff);
  
  digitalWrite(chipSelectPin, HIGH);
}

const byte CRC_TABLE[] = {
0x00, 0x31, 0x62, 0x53, 0xc4, 0xf5, 0xa6, 0x97,
0xb9, 0x88, 0xdb, 0xea, 0x7d, 0x4c, 0x1f, 0x2e,
0x43, 0x72, 0x21, 0x10, 0x87, 0xb6, 0xe5, 0xd4,
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0x3b, 0x0a, 0x59, 0x68, 0xff, 0xce, 0x9d, 0xac,
};

byte calc_crc(byte *data, byte cnt)
{
  int i;
  byte crc = 0;
  for (i = 0; i < cnt; i++) 
    crc = CRC_TABLE[(data[i] ^ crc)];
  return crc;
}
